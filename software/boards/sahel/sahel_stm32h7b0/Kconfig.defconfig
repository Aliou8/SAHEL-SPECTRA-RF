## software/boards/sahel/sahel_stm32h7b0/Kconfig.defconfig
```kconfig
# Copyright (c) 2024 pollelsat
# SPDX-License-Identifier: Apache-2.0

if BOARD_SAHEL_STM32H7B0

source "boards/common/usb/Kconfig.cdc_acm_serial.defconfig"

endif # BOARD_SAHEL_STM32H7B0
```

## software/boards/sahel/sahel_stm32h7b0/Kconfig.sahel_stm32h7b0
```kconfig
# Copyright (c) 2024 pollelsat
# SPDX-License-Identifier: Apache-2.0

config BOARD_SAHEL_STM32H7B0
	select SOC_STM32H7B0XX
```

## software/boards/sahel/sahel_stm32h7b0/board.yml
```yaml
board:
  name: sahel_stm32h7b0
  full_name: Sahel PCB for CubeSat STM32H7B0
  vendor: sahel
  socs:
    - name: stm32h7b0xx
  
```

## software/modules/bq76907/drivers/bq76907/Kconfig
```kconfig
#Copyright (c) 2025 pollelsat
#SPDX-License-Identifier: Apache-2.0


config BATP_BQ76907
    bool "BQ76907 I2C BATTERY PROTECTION"
    default n
    depends on DT_HAS_TI_BQ76907_ENABLED
    select I2C
    help
      Enable BQ76907 I2C battery protection
```

## software/modules/bq76907/dts/bindings/ti,bq76907.yml
```yaml
# SPDX-License-Identifier: Apache-2.0
# Copyright (c) 2026 pollelsat

description: |
  Texas Instruments BQ76907 battery monitor / protection AFE.

  Provides:
    - cell voltage monitoring
    - current measurement (shunt-based)
    - protection (OV/UV/OC/SC)
    - ALERT interrupt signal

compatible: "ti,bq76907"

include:
  - name: i2c-device.yaml
  - name: sensor-device.yaml

properties:
  alert-gpios:
    type: phandle-array
    description: |
      ALERT output from BQ76907.
      Open-drain, active-low. Requires pull-up.

  overvoltage-threshold:
    type: int
    required: true
    description: Over-voltage protection threshold in mV.

  undervoltage-threshold:
    type: int
    required: true
    description: Under-voltage protection threshold in mV.
  overcurrent-in-charge-threshold:
    type: int
    required: true
    description: Overcurrent in charge protection threshold in mA .
  overcurrent-in-discharge1-threshold:
    type: int
    required: true
    description: Overcurrent in decharge protection threshold in mA .
  overcurrent-in-discharge2-threshold:
    type: int
    required: true
    description: Overcurrent in decharge protection threshold in mA .

  number-cell:
    type: int
    required: true
    enum: [1, 2, 3, 4, 5, 6, 7]

  rsense_mohms:
    type: int
    required: true
    default: 0
    description: |
      Equivalent resistance of external voltage divider in milli-ohms (mΩ).
      Used for scaling ADC voltage measurements.
      Set to 0 if not used or measurement is internal to AFE.
```

## software/modules/cc1125/drivers/cc1125/Kconfig
```kconfig
#Copyright (c) 2025 pollelsat
#SPDX-License-Identifier: Apache-2.0


config RADIO_CC1125
    bool "CC1125 SPI RADIO TRANSCEIVER"
    default n
    depends on DT_HAS_TI_CC1125_ENABLED
    select SPI
    help
      Enable CC1125 SPI radio transceiver
```

## software/modules/cc1125/dts/bindings/radio/ti,cc1125.yml
```yaml
#Copyright (c) 2026 pollelsat
#SPDX-License-Identifier: Apache-2.0

description: |
  Ti CC1125 device is a fully integrated single-chip radio transceiver designed 
  for high performance at very low-power and low-voltage operation in cost-effective 
  wireless systems.

include: spi-device.yaml

compatible: "ti,cc1125"

properties:
  gpio0-gpios:
    type: phandle-array
    description: |
      GPIOs connected to the GPIO0 pin of the transceiver.
  gpio1-gpios:
    type: phandle-array
    description: |
      GPIOs connected to the GPIO1 pin of the transceiver.
  gpio2-gpios:
    type: phandle-array
    description: |
      GPIOs connected to the GPIO2 pin of the transceiver.
  gpio3-gpios:
    type: phandle-array
    description: |
      GPIOs connected to the GPIO3 pin of the transceiver.
  frequency:
    type: int
    description: |
      The carrier frequency, in Hz.
  datarate:
    type: int
    description: |
      The datarate in symbol per second.
  spi-max-frequency:
    type: int
    description: |
      The maximum frequency supported by the transceiver.

  
```

## software/modules/fm24cl64b/Kconfig
```kconfig
#Copyright (c) 2025 pollelsat
#SPDX-License-Identifier: Apache-2.0

rsource "drivers/Kconfig"
```

## software/modules/fm24cl64b/drivers/fm24cl64b/Kconfig
```kconfig
#Copyright (c) 2025 pollelsat
#SPDX-License-Identifier: Apache-2.0


config FRAM_FM24CL64B
    bool "FM24CL64B I2C FRAM"
    default n
    depends on DT_HAS_INFINEON_FM24CL64B_ENABLED
    select I2C
    select EEPROM
    help
      Enable FM24CL64B I2C FRAM
```
