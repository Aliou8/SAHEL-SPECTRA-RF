## CMakeLists.txt
```
cmake_minimum_required(VERSION 3.20.0)

set(ZEPHYR_EXTRA_MODULES "${CMAKE_SOURCE_DIR}/../modules/fm24cl64b"
                            "${CMAKE_SOURCE_DIR}/../modules/bq76907")

list(APPEND BOARD_ROOT ${CMAKE_CURRENT_SOURCE_DIR})

find_package(Zephyr REQUIRED HINTS $ENV{ZEPHYR_BASE})

project(SAHEL_CUBESAT)

target_sources(app PRIVATE
    src/main.c
)
```

## prj.conf
```kconfig
# Copyright (c) 2021 Nordic Semiconductor ASA
# SPDX-License-Identifier: Apache-2.0
#
# This file contains selected Kconfig options for the application.

CONFIG_SENSOR=y

CONFIG_FRAM_FM24CL64B=y 

CONFIG_BATP_BQ76907=y

CONFIG_IEEE802154_CC1200=y

CONFIG_TMP112=y
CONFIG_BMP388=y
CONFIG_INA219=y
CONFIG_LSM9DS1=y
CONFIG_RTC_RV8803=y
```

## src/main.c
```c
#include <zephyr/kernel.h>
#include <zephyr/device.h>
#include <zephyr/drivers/sensor.h>
#include <zephyr/sys/printk.h>

#include "bq76907.h"

#define BQ76907_NODE DT_INST(0, ti_bq76907)

int main(void)
{
    const struct device *dev = DEVICE_DT_GET(BQ76907_NODE);

    if (!device_is_ready(dev)) {
        printk("BQ76907 not ready\n");
        return -1;
    }

    struct sensor_value val;

    while (1) {

        sensor_sample_fetch(dev);

        sensor_channel_get(dev, SENSOR_CHAN_VOLTAGE, &val);
        printk("Pack voltage: %d.%06d V\n", val.val1, val.val2);

        sensor_channel_get(dev, SENSOR_CHAN_DIE_TEMP, &val);
        printk("Temp: %d C\n", val.val1);

        sensor_channel_get(dev, BQ76907_CHAN_IS_CHARGING, &val);
        printk("Charging: %d\n", val.val1);

        k_sleep(K_SECONDS(2));
    }
}
```
